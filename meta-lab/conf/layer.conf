## meta-lab/conf/layer.conf
```bitbake
BBPATH .= ":${LAYERDIR}"
BBFILES += "${LAYERDIR}/recipes-*/*/*.bb ${LAYERDIR}/recipes-*/*/*.bbappend"

BBFILE_COLLECTIONS += "lab"
BBFILE_PATTERN_lab = "^${LAYERDIR_RE}/"
BBFILE_PRIORITY_lab = "6"

LAYERVERSION_lab = "1"
LAYERSERIES_COMPAT_lab = "v0.6"
LAYERDIR_lab = "${LAYERDIR}"
```
